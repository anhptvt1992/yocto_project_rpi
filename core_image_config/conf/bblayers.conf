## core_image_config/conf/bblayers.conf
```bitbake
# POKY_BBLAYERS_CONF_VERSION is increased each time build/conf/bblayers.conf
# changes incompatibly
POKY_BBLAYERS_CONF_VERSION = "2"

BBPATH = "${TOPDIR}"
BBFILES ?= ""

BBLAYERS ?= " \
  /home/anhpt26/rpi-tools/yocto_rpi/poky/meta \
  /home/anhpt26/rpi-tools/yocto_rpi/poky/meta-poky \
  /home/anhpt26/rpi-tools/yocto_rpi/poky/meta-yocto-bsp \
  /home/anhpt26/rpi-tools/yocto_rpi/meta-raspberrypi \
  /home/anhpt26/rpi-tools/yocto_rpi/meta-openembedded/meta-oe \
  /home/anhpt26/rpi-tools/yocto_rpi/meta-openembedded/meta-python \
  /home/anhpt26/rpi-tools/yocto_rpi/meta-openembedded/meta-multimedia \
  /home/anhpt26/rpi-tools/yocto_rpi/meta-openembedded/meta-networking \
  /home/anhpt26/rpi-tools/yocto_rpi/meta-qt5 \
  "
```
